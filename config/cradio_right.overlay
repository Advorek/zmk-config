/ {
    chosen {
        zephyr,display = &oled;
    };
};

&pro_micro_i2c {
    status = "okay";

    oled: ssd1306@3c {
        compatible = "solomon,ssd1306fb";
        reg = <0x3c>;
        width = <128>;
        height = <32>;   /* Zmień na 64, jeśli Twój ekran fizycznie ma 64 piksele wysokości */
        
        /* Te dwie linie odpowiadają za prawidłową orientację obrazu i brak pasków */
        segment-remap;
        com-invdir;
        
        page-offset = <0>;
        display-offset = <0>;
        multiplex-ratio = <31>; /* Jeśli zmienisz wysokość na 64, zmień tę wartość na 63 */
        segment-offset = <0>;
        com-sequential;
        prechargep = <0x22>;
    };
};
