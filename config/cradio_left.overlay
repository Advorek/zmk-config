/ {
    chosen {
        zephyr,display = &oled;
    };
};

&pro_micro_i2c {
    status = "okay";

    oled: ssd1306@3c {
        compatible = "solomon,ssd1306fb";
        reg = <0x3c>;
        width = <128>;
        height = <32>;
        
        /* Zmiana: Usunięto segment-remap i com-invdir dla usunięcia pasków */
        page-offset = <0>;
        display-offset = <0>;
        multiplex-ratio = <31>;
        segment-offset = <0>;
        com-sequential;
        prechargep = <0x22>;
    };
};
